led_strip: ws2812 {
    compatible = "worldsemi,ws2812-spi";
    status = "okay";

    chain-length = <10>;
    spi-one-frame = <0x70>;
    spi-zero-frame = <0x40>;
};

/ {
    chosen {
        zmk,underglow = &led_strip;
    };
};
& i2c0 {
    status = "okay";

    oled: ssd1306@3c {
        compatible = "solomon,ssd1306fb";
        reg = <0x3c>;
        label = "OLED";
        width = <128>;
        height = <32>;
    };
};

/ {
    chosen {
        zmk,display = &oled;
    };
};